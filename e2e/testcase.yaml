## e2e/testcase.yaml
```yaml
# (C) Copyright 2024-2026, SECO Mind Srl
#
# SPDX-License-Identifier: Apache-2.0

tests:
  edgehog_device.e2e.default:
    filter: CONFIG_SERIAL and dt_chosen_enabled("zephyr,shell-uart")
    harness: pytest
    harness_config:
      pytest_dut_scope: "session"
      # only run tests marked with 'default'
      pytest_args: ["-m", "default"]
    timeout: 300
    platform_allow: [qemu_x86, native_sim]
    integration_platforms: [native_sim]
    tags:
      - e2e
      - pytest

  edgehog_device.e2e.file_transfer:
    filter: CONFIG_SERIAL and dt_chosen_enabled("zephyr,shell-uart")
    harness: pytest
    harness_config:
      pytest_dut_scope: "session"
      # only run tests marked with 'file_transfer'
      pytest_args: ["-m", "file_transfer"]
    timeout: 300
    platform_allow: [qemu_x86, native_sim]
    integration_platforms: [native_sim]
    tags:
      - e2e
      - pytest
      - ft
    extra_configs:
      - CONFIG_EDGEHOG_DEVICE_FILE_TRANSFER=y
      - CONFIG_EDGEHOG_DEVICE_FILE_TRANSFER_COMPRESSION=y
```

## lib/Kconfig
```kconfig
# (C) Copyright 2024, SECO Mind Srl
#
# SPDX-License-Identifier: Apache-2.0

menu "Edgehog device"

rsource "edgehog_device/Kconfig"

rsource "../../astarte-device-sdk-zephyr/Kconfig"

endmenu
```

## lib/edgehog_device/Kconfig
```kconfig
# (C) Copyright 2024, SECO Mind Srl
#
# SPDX-License-Identifier: Apache-2.0

config EDGEHOG_DEVICE
	bool "Edgehog device library"
	select ASTARTE_DEVICE_SDK
	select NVS
	select IMG_MANAGER
	select FLASH
	select FLASH_MAP
	select FLASH_PAGE_LAYOUT
	select STREAM_FLASH
	select REBOOT
	help
	  This option enables the Edgehog device library

config EDGEHOG_DEVICE_SERIAL_NUMBER
	string "Serial number that will identify this device"
	depends on EDGEHOG_DEVICE
	help
	  The value passed as part of SystemInfo interface.

config EDGEHOG_DEVICE_PART_NUMBER
	string "Part number that will identify this device in ota campaigns"
	depends on EDGEHOG_DEVICE
	help
	  This changes the value passed as part of SystemInfo interface.
config EDGEHOG_DEVICE_CA_CERT_OTA_TAG
	int "CA root certificate TLS security tag for the OTA download URL"
	depends on EDGEHOG_DEVICE
	depends on !EDGEHOG_DEVICE_DEVELOP_DISABLE_OR_IGNORE_TLS
	help
	  The CA certificate should be added by the user with the tls_credential_add function.
	  This configuration option should be set to the tag used when adding the CA certificate.

config EDGEHOG_DEVICE_USE_EDGEHOG_PARTITION
	bool "Enable edgehog_partition NVS partition label for edgehog storage"
	depends on EDGEHOG_DEVICE
	default false
	help
		Use this option to use edgehog_partition NVS partition for storing the edgehog data.
		In order to use it, the board.dts must cointain the `edgehog_partion` node,
		or it must be provided by dts overlay.

config EDGEHOG_DEVICE_ZBUS_OTA_EVENT
	bool "Enable ZBus OTA channel for receiving OTA event"
	depends on EDGEHOG_DEVICE
	select ZBUS
	default false
	help
		Enable this option to receive OTA events in a ZBus observers.
		Receiving it in Subscriber(asynchronous), or Message subscribers(asynchronous),
		is preferred over Listener (synchronous), because it is received
		in a separate context of the publisher, without blocking the OTA thread.

menu "Development options"

config EDGEHOG_DEVICE_DEVELOP_DISABLE_OR_IGNORE_TLS
	bool "Disable TLS for all sockets"
	depends on EDGEHOG_DEVICE
	default false
	help
	  Enable this option to connect to a local Edgehog instance.
	  With this option enabled:
	  - All HTTP(s) operations will be performed over an unsecure channel. Without TLS.
	  	However, any error related the server certificate will be ignored.

	  Should be used only for development purposes as it's highly unsafe.

endmenu

menu "Logging options"

module = EDGEHOG_DEVICE_DEVICE
module-str = Log level for Edgehog device
module-help = Sets log level for Edgehog device.
source "subsys/logging/Kconfig.template.log_config"

module = EDGEHOG_DEVICE_HARDWARE_INFO
module-str = Log level for Edgehog device hardware informantions
module-help = Sets log level for Edgehog device hardware informantions.
source "subsys/logging/Kconfig.template.log_config"

module = EDGEHOG_DEVICE_OS_INFO
module-str = Log level for Edgehog device operating system informantions
module-help = Sets log level for Edgehog device operating system informantions.
source "subsys/logging/Kconfig.template.log_config"

module = EDGEHOG_DEVICE_SYSTEM_INFO
module-str = Log level for Edgehog device system informantions
module-help = Sets log level for Edgehog device system informantions.
source "subsys/logging/Kconfig.template.log_config"

module = EDGEHOG_DEVICE_BASE_IMAGE
module-str = Log level for Edgehog device software image informations
module-help = Sets log level for Edgehog device software image informations.
source "subsys/logging/Kconfig.template.log_config"

module = EDGEHOG_DEVICE_UTIL
module-str = Log level for Edgehog device utility functions
module-help = Sets log level for Edgehog device utility functions.
source "subsys/logging/Kconfig.template.log_config"

module = EDGEHOG_DEVICE_HTTP
module-str = Log level for Edgehog device connectivity utilities
module-help = Sets log level for Edgehog device connectivity utilities.
source "subsys/logging/Kconfig.template.log_config"

module = EDGEHOG_DEVICE_OTA
module-str = Log level for Edgehog device OTA utilities
module-help = Sets log level for Edgehog device OTA utilities.
source "subsys/logging/Kconfig.template.log_config"

module = EDGEHOG_DEVICE_NVS
module-str = Log level for Edgehog device NVS utilities
module-help = Sets log level for Edgehog device NVS utilities.
source "subsys/logging/Kconfig.template.log_config"

module = EDGEHOG_DEVICE_COMMAND
module-str = Log level for Edgehog device Command utilities
module-help = Sets log level for Edgehog device Command utilities.
source "subsys/logging/Kconfig.template.log_config"

module = EDGEHOG_DEVICE_RUNTIME_INFO
module-str = Log level for Edgehog device Runtime informantions
module-help = Sets log level for Edgehog device Runtime informantions.
source "subsys/logging/Kconfig.template.log_config"

module = EDGEHOG_DEVICE_SYSTEM_STATUS
module-str = Log level for Edgehog device System status informantions
module-help = Sets log level for Edgehog device System status informantions.
source "subsys/logging/Kconfig.template.log_config"

module = EDGEHOG_DEVICE_STORAGE_USAGE
module-str = Log level for Edgehog device Storage usage informantions
module-help = Sets log level for Edgehog device Storage usage informantions.
source "subsys/logging/Kconfig.template.log_config"

module = EDGEHOG_DEVICE_LED
module-str = Log level for Edgehog device led controller.
module-help = Sets log level for Edgehog device led controller.
source "subsys/logging/Kconfig.template.log_config"

endmenu
```

## samples/edgehog_app/boards/mimxrt1060_evkb.conf
```kconfig
# (C) Copyright 2024, SECO Mind Srl
#
# SPDX-License-Identifier: Apache-2.0

# Ethernet settings
CONFIG_NET_L2_ETHERNET=y
CONFIG_NET_L2_ETHERNET_MGMT=y

CONFIG_ASTARTE_DEVICE_SDK_PERMANENT_STORAGE=y
CONFIG_EDGEHOG_DEVICE_USE_EDGEHOG_PARTITION=y

CONFIG_MBEDTLS_ENABLE_HEAP=n
CONFIG_LOG_MODE_DEFERRED=y
CONFIG_LOG_BUFFER_SIZE=32768
```

## samples/edgehog_app/boards/native_sim.conf
```kconfig
# (C) Copyright 2024, SECO Mind Srl
#
# SPDX-License-Identifier: Apache-2.0

CONFIG_PICOLIBC_USE_MODULE=y
CONFIG_PICOLIBC=y

# Ethernet settings
CONFIG_NET_L2_ETHERNET=y
CONFIG_NET_L2_ETHERNET_MGMT=y

# Enable the file transfer
CONFIG_EDGEHOG_DEVICE_FILE_TRANSFER=y
CONFIG_EDGEHOG_DEVICE_FILE_TRANSFER_HTTPS_CA_CERT_TAG=4
CONFIG_EDGEHOG_DEVICE_FILE_TRANSFER_COMPRESSION=y
CONFIG_EDGEHOG_DEVICE_FILE_TRANSFER_TAR=y
```

## samples/edgehog_app/boards/stm32h573i_dk.conf
```kconfig
# (C) Copyright 2024, SECO Mind Srl
#
# SPDX-License-Identifier: Apache-2.0

# Unfortunately this board does not have the resources for this feature.
CONFIG_EDGEHOG_DEVICE_FILE_TRANSFER_COMPRESSION=n

# Enable LZ4 compression
CONFIG_LZ4=n
CONFIG_LZ4_FRAME_SUPPORT=n

# Use a small log buffer size
CONFIG_LOG_BUFFER_SIZE=2048
```

## tests/lib/edgehog_device/integration/testcase.yaml
```yaml
# (C) Copyright 2024, SECO Mind Srl
#
# SPDX-License-Identifier: Apache-2.0

tests:
  lib.edgehog_device.integration:
    tags: edgehog_device
    platform_allow:
      - native_sim
    integration_platforms:
      - native_sim
```

## tests/lib/edgehog_device/unit/testcase.yaml
```yaml
# (C) Copyright 2026, SECO Mind Srl
#
# SPDX-License-Identifier: Apache-2.0

tests:
  lib.edgehog_device.unit:
    tags: edgehog_device
    type: unit
```

## west.yml
```yaml
# (C) Copyright 2024, SECO Mind Srl
#
# SPDX-License-Identifier: Apache-2.0

manifest:

  remotes:
    - name: zephyrproject-rtos
      url-base: https://github.com/zephyrproject-rtos
    - name: astarte-platform
      url-base: https://github.com/astarte-platform
    - name: edgehog-device-manager
      url-base: https://github.com/edgehog-device-manager

  projects:
    - name: zephyr
      remote: zephyrproject-rtos
      revision: v4.4.0
      import: true
    - name: astarte-device-sdk-zephyr
      remote: astarte-platform
      revision: release-0.10
      import: true
    - name: edgehog-astarte-interfaces
      remote: edgehog-device-manager
      revision: c327c82289d3e28b0d99360fe0d9456367fa8bf7
    - name: lz4
      url: https://github.com/zephyrproject-rtos/lz4
      revision: zephyr
      path: modules/lib/lz4
```
