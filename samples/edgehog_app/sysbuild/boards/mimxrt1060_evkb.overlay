/*
 * (C) Copyright 2024, SECO Mind Srl
 *
 * SPDX-License-Identifier: Apache-2.0
 */

#include "../../boards/mimxrt1060_evkb.overlay"

/ {
	chosen {
		zephyr,code-partition = &boot_partition;
	};
};
