## CMakeLists.txt
```
# (C) Copyright 2024, SECO Mind Srl
#
# SPDX-License-Identifier: Apache-2.0

cmake_minimum_required(VERSION 3.20.0)
find_package(Zephyr REQUIRED HINTS $ENV{ZEPHYR_BASE})
project(edgehog_device_integration)

target_include_directories(app PRIVATE
        ${ZEPHYR_BASE}/../edgehog-zephyr-device/lib/edgehog_device/include
)

FILE(GLOB test_sources src/*.c)
target_sources(app PRIVATE ${test_sources})
```

## prj.conf
```kconfig
# (C) Copyright 2024, SECO Mind Srl
#
# SPDX-License-Identifier: Apache-2.0
#
# This is a Kconfig fragment which can be used to enable debug-related options
# in the application. See the README for more details.

CONFIG_ZTEST=y

# Set C libraries
CONFIG_PICOLIBC=y
CONFIG_PICOLIBC_USE_MODULE=y

# Astarte device SDK
CONFIG_ASTARTE_DEVICE_SDK=y
CONFIG_ASTARTE_DEVICE_SDK_HOSTNAME="."
# The two certificate tags are the same as the root CA is the same for Astarte API and MQTT broker.
CONFIG_ASTARTE_DEVICE_SDK_HTTPS_CA_CERT_TAG=1
CONFIG_ASTARTE_DEVICE_SDK_MQTTS_CA_CERT_TAG=1
CONFIG_ASTARTE_DEVICE_SDK_CLIENT_CERT_TAG=2
CONFIG_ASTARTE_DEVICE_SDK_PAIRING_JWT=""
CONFIG_ASTARTE_DEVICE_SDK_REALM_NAME="."
CONFIG_ASTARTE_DEVICE_SDK_PERMANENT_STORAGE=n

# Edgehog device
CONFIG_EDGEHOG_DEVICE=y
CONFIG_EDGEHOG_DEVICE_OTA_HTTPS_CA_CERT_TAG=3
CONFIG_EDGEHOG_DEVICE_ZBUS_OTA_EVENT=y
# System info interface data
CONFIG_EDGEHOG_DEVICE_PART_NUMBER=""
CONFIG_EDGEHOG_DEVICE_SERIAL_NUMBER=""

# Enable logging with floating point support
CONFIG_LOG=y
CONFIG_REQUIRES_FLOAT_PRINTF=y
CONFIG_CBPRINTF_FP_SUPPORT=y

# Increase minimum heap size.
CONFIG_HEAP_MEM_POOL_SIZE=16384

# Increased stack size
CONFIG_MAIN_STACK_SIZE=8192

# Use custom heap
CONFIG_ASTARTE_DEVICE_SDK_ENABLE_HEAP=y

# Enable base64 encoding and decoding
CONFIG_BASE64=y

# Enable system hashmaps
CONFIG_SYS_HASH_MAP=y

# Enable JSON library
CONFIG_JSON_LIBRARY=y

# Enable entropy generator
CONFIG_ENTROPY_GENERATOR=y

# DNS resolver
CONFIG_DNS_RESOLVER=y
CONFIG_DNS_SERVER_IP_ADDRESSES=y
CONFIG_DNS_SERVER1="8.8.8.8" # Google DNS

# Base MbedTLS & heap configuration
CONFIG_MBEDTLS=y
CONFIG_MBEDTLS_BUILTIN=y
CONFIG_MBEDTLS_ENABLE_HEAP=y
CONFIG_MBEDTLS_HEAP_SIZE=95000

# Enable PSA Crypto Backend
CONFIG_PSA_CRYPTO=y
CONFIG_PSA_CRYPTO_ENABLE_ALL=y
CONFIG_MBEDTLS_PSA_CRYPTO_C=y

# TLS & X.509
CONFIG_MBEDTLS_SSL_MAX_CONTENT_LEN=8192
CONFIG_MBEDTLS_PEM_PARSE_C=y
CONFIG_MBEDTLS_PEM_WRITE_C=y
CONFIG_MBEDTLS_BASE64_C=y
CONFIG_MBEDTLS_PK_WRITE_C=y
CONFIG_MBEDTLS_SSL_PROTO_TLS1_2=y
CONFIG_MBEDTLS_SSL_SERVER_NAME_INDICATION=y
CONFIG_MBEDTLS_X509_USE_C=y
CONFIG_MBEDTLS_X509_CRT_PARSE_C=y
CONFIG_MBEDTLS_X509_CRL_PARSE_C=y
CONFIG_MBEDTLS_X509_CSR_PARSE_C=y
CONFIG_MBEDTLS_X509_CSR_WRITE_C=y
CONFIG_MBEDTLS_PKCS5_C=y
CONFIG_MBEDTLS_KEY_EXCHANGE_ECDHE_ECDSA_ENABLED=y
CONFIG_MBEDTLS_KEY_EXCHANGE_ECDHE_RSA_ENABLED=y

# Enable networking
CONFIG_NETWORKING=y

# Sockets
CONFIG_NET_SOCKETS=y
CONFIG_NET_SOCKETS_SOCKOPT_TLS=y

# Use DHCP for IPv4 and IPv6
CONFIG_NET_DHCPV4=y
CONFIG_NET_DHCPV6=y

# Generic networking options
CONFIG_NET_TX_STACK_SIZE=4096
CONFIG_NET_RX_STACK_SIZE=4096
CONFIG_NET_PKT_RX_COUNT=20
CONFIG_NET_PKT_TX_COUNT=20
CONFIG_NET_BUF_RX_COUNT=40
CONFIG_NET_BUF_TX_COUNT=40
CONFIG_NET_MAX_CONTEXTS=20
CONFIG_NET_MAX_CONN=6
CONFIG_NET_MGMT=y
CONFIG_NET_MGMT_EVENT=y
CONFIG_NET_IPV4=y
CONFIG_NET_IPV6=y
CONFIG_NET_TCP=y

# Enable HTTP client
CONFIG_HTTP_CLIENT=y

# MQTT options
CONFIG_MQTT_LIB=y
CONFIG_MQTT_LIB_TLS=y
CONFIG_MQTT_KEEPALIVE=60

# Enable flash
CONFIG_FLASH=y
CONFIG_FLASH_MAP=y
CONFIG_FLASH_PAGE_LAYOUT=y

# Enable NVS
CONFIG_NVS=y
CONFIG_NVS_LOG_LEVEL_WRN=y

# Enable storage
CONFIG_ZMS=y
CONFIG_ZMS_LOG_LEVEL_WRN=y

# Enable hash functions
CONFIG_SYS_HASH_FUNC32=y
CONFIG_SYS_HASH_FUNC32_MURMUR3=y

# Edgehog depends on
CONFIG_IMG_MANAGER=y
CONFIG_STREAM_FLASH=y
CONFIG_REBOOT=y

CONFIG_DNS_RESOLVER_AI_MAX_ENTRIES=4
CONFIG_NET_SOCKETS_TLS_MAX_CONTEXTS=4
CONFIG_TLS_MAX_CREDENTIALS_NUMBER=8

CONFIG_THREAD_MONITOR=y
CONFIG_INIT_STACKS=y
CONFIG_THREAD_STACK_INFO=y

CONFIG_ZVFS_OPEN_MAX=26

CONFIG_SNTP=y
CONFIG_NET_CONFIG_CLOCK_SNTP_INIT=y
CONFIG_NET_CONFIG_SNTP_INIT_SERVER="0.pool.ntp.org"
CONFIG_NET_CONFIG_SNTP_INIT_TIMEOUT=3000

# Enable the settings
CONFIG_SETTINGS=y

# Activate Zbus
CONFIG_ZBUS=y

# Activate thread naming
CONFIG_THREAD_NAME=y

# Enable events
CONFIG_EVENTS=y

# Increase the system workqueue stack
CONFIG_SYSTEM_WORKQUEUE_STACK_SIZE=4096

# Enable UUID
CONFIG_UUID=y
CONFIG_UUID_V4=y
CONFIG_UUID_V5=y
CONFIG_UUID_BASE64=y

# Enable LZ4 compression
CONFIG_LZ4=y
CONFIG_LZ4_FRAME_SUPPORT=y

# Enable scoped cleanup helpers
CONFIG_SCOPE_CLEANUP_HELPERS=y
```

## src/main.c
```c
/*
 * (C) Copyright 2024, SECO Mind Srl
 *
 * SPDX-License-Identifier: Apache-2.0
 */

/*
 * @file edgehog-zephyr-device/tests/lib/edgehog_device_sdk/unit/src/main.c
 *
 * @details This test suite verifies that the methods provided with the edgehog_device
 * module works correctly.
 *
 * @note This should be run with the latest version of zephyr present on master (or 3.6.0)
 */

#include <zephyr/ztest.h>

#include <edgehog_device/device.h>

// Define a minimal_log function to resolve the `undefined reference to z_log_minimal_printk` error,
// because the log environment is missing in the unit_testing platform.
void z_log_minimal_printk(const char *fmt, ...) {}

ZTEST(edgehog_device, test_edgehog_device_new)
{
    // Configuration options for the Astarte device
    astarte_device_config_t astarte_device_config = {
        .http_timeout_ms = 1000,
        .mqtt_connection_timeout_ms = 100,
        .mqtt_poll_timeout_ms = 100,
        .cred_secr = "Placeholder",
        .device_id = "Placeholder",
    };

    edgehog_device_config_t edgehog_conf = {
        .astarte_device_config = astarte_device_config,
    };

    edgehog_device_handle_t edgehog_device = NULL;
    edgehog_result_t edgehog_result = edgehog_device_new(&edgehog_conf, &edgehog_device);

    zassert_true(edgehog_result != EDGEHOG_RESULT_OK,
        "Result of edgehog device creation with edgehog_device_new is EDGEHOG_RESULT_OK");

    zassert_true(edgehog_device == NULL, "Device created with edgehog_device_new is not NULL");
}

ZTEST_SUITE(edgehog_device, NULL, NULL, NULL, NULL, NULL);
```
